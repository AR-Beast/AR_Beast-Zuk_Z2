## arch/arm64/hotplug/Kconfig
```kconfig
config LAZYPLUG
       bool "LazyPlug HotPlug, developed by arter97."
       default y
       help
	    Based on IntelliPlug, this HotPlug uses a Conservative Approach
	    towards HotPlugging. This HotPlug is Developed by arter97 and 
	    Enhanced by fraps129.

config ALUCARD_HOTPLUG
	bool "Enable alucard-hotplug cpu hotplug driver"
	default n
	help
	Generic Alucard-hotplug cpu hotplug driver for ARM SOCs
```
